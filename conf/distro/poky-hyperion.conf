## conf/distro/poky-hyperion.conf
```bitbake
DISTRO = "poky-hyperion"
DISTRO_NAME = "Hyperion"
DISTRO_VERSION = "1.0"
DISTRO_CODENAME = "hyperion"
SDK_VENDOR = "-hyperionsdk"
SDK_VERSION := "${@'${DISTRO_VERSION}'.replace('snapshot-${DATE}','snapshot')}"

MAINTAINER = "Thomas Coin <esvcorp@gmail.com>"

TARGET_VENDOR = "-hyperion"

LOCALCONF_VERSION = "1"

# Override these in hyperion based distros
HYPERION_DEFAULT_DISTRO_FEATURES = "largefile opengl ptest multiarch"
HYPERION_DEFAULT_EXTRA_RDEPENDS = "packagegroup-core-boot"
HYPERION_DEFAULT_EXTRA_RRECOMMENDS = "kernel-module-af-packet"

DISTRO_FEATURES ?= "${DISTRO_FEATURES_DEFAULT} ${DISTRO_FEATURES_LIBC} ${HYPERION_DEFAULT_DISTRO_FEATURES}"
DISTRO_FEATURES_remove  = "x11"

# Forces systemd as init manager
#VIRTUAL-RUNTIME_init_manager = "systemd"
#DISTRO_FEATURES_BACKFILL_CONSIDERED = "sysvinit"

# Force to install systemd-compat-units package when using this distro
#IMAGE_INSTALL += "systemd-compat-units"

PREFERRED_VERSION_linux-yocto ?= "4.1%"
PREFERRED_VERSION_linux-yocto_qemux86 ?= "4.1%"
PREFERRED_VERSION_linux-yocto_qemux86-64 ?= "4.1%"
PREFERRED_VERSION_linux-yocto_qemuarm ?= "4.1%"
PREFERRED_VERSION_linux-yocto_qemumips ?= "4.1%"
PREFERRED_VERSION_linux-yocto_qemumips64 ?= "4.1%"
PREFERRED_VERSION_linux-yocto_qemuppc ?= "4.1%"

SDK_NAME = "${DISTRO}-${TCLIBC}-${SDK_ARCH}-${IMAGE_BASENAME}-${TUNE_PKGARCH}"
SDKPATH = "/opt/${DISTRO}/${SDK_VERSION}"

DISTRO_EXTRA_RDEPENDS += " ${HYPERION_DEFAULT_EXTRA_RDEPENDS}"
DISTRO_EXTRA_RRECOMMENDS += " ${HYPERION_DEFAULT_EXTRA_RRECOMMENDS}"

HYPERIONQEMUDEPS = "${@bb.utils.contains("INCOMPATIBLE_LICENSE", "GPL-3.0", "", "packagegroup-core-device-devel",d)}"
DISTRO_EXTRA_RDEPENDS_append_qemuarm = " ${HYPERIONQEMUDEPS}"
DISTRO_EXTRA_RDEPENDS_append_qemuarm64 = " ${HYPERIONQEMUDEPS}"
DISTRO_EXTRA_RDEPENDS_append_qemumips = " ${HYPERIONQEMUDEPS}"
DISTRO_EXTRA_RDEPENDS_append_qemuppc = " ${HYPERIONQEMUDEPS}"
DISTRO_EXTRA_RDEPENDS_append_qemux86 = " ${HYPERIONQEMUDEPS}"
DISTRO_EXTRA_RDEPENDS_append_qemux86-64 = " ${HYPERIONQEMUDEPS}"

TCLIBCAPPEND = ""

QEMU_TARGETS ?= "arm aarch64 i386 mips mipsel mips64 ppc x86_64"
# Other QEMU_TARGETS "mips64el sh4"

PREMIRRORS ??= "\
bzr://.*/.*   http://downloads.yoctoproject.org/mirror/sources/ \n \
cvs://.*/.*   http://downloads.yoctoproject.org/mirror/sources/ \n \
git://.*/.*   http://downloads.yoctoproject.org/mirror/sources/ \n \
gitsm://.*/.* http://downloads.yoctoproject.org/mirror/sources/ \n \
hg://.*/.*    http://downloads.yoctoproject.org/mirror/sources/ \n \
osc://.*/.*   http://downloads.yoctoproject.org/mirror/sources/ \n \
p4://.*/.*    http://downloads.yoctoproject.org/mirror/sources/ \n \
svn://.*/.*   http://downloads.yoctoproject.org/mirror/sources/ \n"

MIRRORS =+ "\
ftp://.*/.*      http://downloads.yoctoproject.org/mirror/sources/ \n \
http://.*/.*     http://downloads.yoctoproject.org/mirror/sources/ \n \
https://.*/.*    http://downloads.yoctoproject.org/mirror/sources/ \n"

# The CONNECTIVITY_CHECK_URI's are used to test whether we can succesfully
# fetch from the network (and warn you if not). To disable the test set
# the variable to be empty.
# Git example url: git://git.yoctoproject.org/yocto-firewall-test;protocol=git;rev=master

CONNECTIVITY_CHECK_URIS ?= " \
             https://eula-downloads.yoctoproject.org/index.php \
             http://bugzilla.yoctoproject.org/report.cgi"

SANITY_TESTED_DISTROS ?= " \
            hyperion-1.7 \n \
            hyperion-1.8 \n \
            hyperion-2.0 \n \
            Ubuntu-14.04 \n \
            Ubuntu-14.10 \n \
            Ubuntu-15.04 \n \
            Ubuntu-15.10 \n \
            Fedora-21 \n \
            Fedora-22 \n \
            CentOS-6.* \n \
            CentOS-7.* \n \
            Debian-7.* \n \
            Debian-8.* \n \
            openSUSE-project-13.2 \n \
            "

# Default hash policy for distro
BB_SIGNATURE_HANDLER ?= 'OEBasicHash'
#
# OELAYOUT_ABI allows us to notify users when the format of TMPDIR changes in
# an incompatible way. Such changes should usually be detailed in the commit
# that breaks the format and have been previously discussed on the mailing list
# with general agreement from the core team.
#
OELAYOUT_ABI = "11"

# add hyperion sanity bbclass
INHERIT += "poky-sanity"

# QA check settings - a little stricter than the OE-Core defaults
WARN_TO_ERROR_QA = "already-stripped compile-host-path install-host-path \
                    installed-vs-shipped ldflags pn-overrides rpaths staticdev \
                    useless-rpaths"
WARN_QA_remove = "${WARN_TO_ERROR_QA}"
ERROR_QA_append = " ${WARN_TO_ERROR_QA}"
```

## conf/layer.conf
```bitbake
# We have a conf and classes directory, add to BBPATH
BBPATH .= ":${LAYERDIR}"

# We have recipes-* directories, add to BBFILES
BBFILES += " \
    ${LAYERDIR}/recipes-*/*/*.bb \
    ${LAYERDIR}/recipes-*/*/*.bbappend \
    "

BBFILE_COLLECTIONS += "hyperion"
BBFILE_PATTERN_hyperion = "^${LAYERDIR}/"
BBFILE_PRIORITY_hyperion = "7"

PREFERRED_PROVIDER_jpeg = "libjpeg-turbo"
PREFERRED_PROVIDER_jpeg-native = "libjpeg-turbo-native"

LAYERDEPENDS_hyperion = "openembedded-layer qt5-layer"

# Sets preferred providers for qemux86
PREFERRED_PROVIDER_virtual/mesa_qemux86 = "mesa"
PREFERRED_PROVIDER_virtual/libgl_qemux86 = "mesa"
PREFERRED_PROVIDER_virtual/libgles2_qemux86 = "mesa"
PREFERRED_PROVIDER_virtual/egl_qemux86 = "mesa"

# Sets qtbase PACKAGECONFIG for qemux86
PACKAGECONFIG_pn-qtbase_append_qemux86 = " accessibility gles2 widgets"
PACKAGECONFIG_X11_pn-qtbase_qemux86 = ""
PACKAGECONFIG_GL_pn-qtbase_qemux86 = ""
```

## meta-raspberrypi/conf/layer.conf
```bitbake
# We have a conf and classes directory, add to BBPATH
BBPATH .= ":${LAYERDIR}"

# We have recipes-* directories, add to BBFILES
BBFILES += "${LAYERDIR}/recipes-*/*/*.bb \
	${LAYERDIR}/recipes-*/*/*.bbappend"

BBFILE_COLLECTIONS += "hyperion-raspberrypi"
BBFILE_PATTERN_hyperion-raspberrypi = "^${LAYERDIR}/"
BBFILE_PRIORITY_hyperion-raspberrypi = "6"

LAYERDEPENDS_hyperion-raspberrypi = "hyperion raspberrypi"

# Enable SPI bus
ENABLE_SPI_BUS = "1"
```
